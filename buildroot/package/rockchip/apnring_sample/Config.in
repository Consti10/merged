## buildroot/package/rockchip/apnring_sample/Config.in
```kconfig
config BR2_PACKAGE_APNRING_SAMPLE
        bool  "apnring sample"
        help
		rv1126 qt_port rtc 4G demo support
```

## buildroot/package/rockchip/apnring_sample_v12/Config.in
```kconfig
config BR2_PACKAGE_APNRING_SAMPLE_V12
        bool  "apnring sample v12"
        help
		rv1126 qt_port rtc 4G demo support
```
